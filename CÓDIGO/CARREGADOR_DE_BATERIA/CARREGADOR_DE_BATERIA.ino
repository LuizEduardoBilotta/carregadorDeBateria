
/*
  @PROJECT: CARREGADOR DE BATERIA 12V
  @DATE: 24/09/2019
  @AUTHOR: LUIZ EDUARDO BILOTTA
  @EMAIL: LUIZEDUARDOBILOTTA@GMAIL.COM
*/


#include <Arduino.h>
#include <Wire.h>
#include <MicroLCD.h>

//DEFINIÇÃO DAS PINAGENS UTILIZADAS
#define sensorTensaoDC A0
#define sensorCorrenteDC A1
#define cortaTensao A2

//DEFINIÇÃO VARIÁVEIS
float valorTensaoDC;
int amostragem = 1000;
float mediaTotalTensaoDC = 0;
float valorFinalTensaoDC = 0;
float R1 = 29800.0;
float R2 = 7550.0;
float voltsPorUnidade = 0.004887586;
bool inicio = true;
int sensorValueAux = 0;
float valorCorrenteDC = 0;
float valorSensorACS712 = 0;
float sensibilidade = 0.100;
float desvioACS712 = 0.045;
String carregamento = "";
int j;
int h = 0;
int interacao = 0;

//CONFIGURAÇÃO DO DISPLAY LCD
LCD_SSD1306 lcd;


//ARRAY LOGO ENGENHARIA MECÂNICA
const PROGMEM uint8_t ENG_MEC_MONO [48*48 /8] = {
0x00, 0x00, 0x00, 0x00, 0x00, 0x00, 0x00, 0x00, 0x00, 0x00, 0x00, 0x80, 0xC0, 0x80, 0x00, 0x18,
0xF8, 0xF0, 0x60, 0xE0, 0x7E, 0x3E, 0xDC, 0xF0, 0x10, 0xBF, 0x1F, 0x7F, 0x90, 0x30, 0xFE, 0x7E,
0x26, 0xE0, 0x60, 0xF8, 0xF8, 0x00, 0x00, 0x80, 0xC0, 0x80, 0x00, 0x00, 0x00, 0x00, 0x00, 0x00,
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0x3A, 0x03, 0x03, 0x0F, 0x0F, 0x04, 0x00, 0x00, 0x01, 0x00, 0x00, 0x00, 0x00, 0x00, 0x00, 0x00
};

//ARRAY LOGO UNIP
const PROGMEM uint8_t UNIP_MONO [48*37 /8] = {
0x00, 0x00, 0x00, 0x00, 0xFC, 0xFE, 0xFE, 0xFE, 0x06, 0x00, 0x00, 0xC0, 0xFE, 0xFE, 0xFE, 0xFE,
0x00, 0x80, 0xFC, 0xFE, 0xFE, 0xFE, 0xE0, 0x00, 0x00, 0x80, 0xFE, 0xFE, 0xFE, 0x3E, 0x00, 0xFC,
0xFE, 0xFE, 0xFE, 0x00, 0x00, 0xFC, 0xFE, 0xFE, 0xFE, 0xFE, 0xFE, 0xFE, 0xFE, 0xFE, 0xFE, 0xFC,
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0x03, 0x00, 0x00, 0x00, 0x00, 0x00, 0x07, 0x03, 0x01, 0x00, 0x00, 0x00, 0x03, 0x03, 
};


void setup() {
  
  //INICIALIZAÇÃO DO LCD
  lcd.begin();
  
  //INICIALIZAÇÃO DA PORTA SERIAL (MONITOR)
  Serial.begin(9600);

  pinMode(sensorTensaoDC, INPUT);
  pinMode(sensorCorrenteDC, INPUT);
  pinMode(cortaTensao, OUTPUT);
}

void loop() {

  //ZERANDO TODAS AS VARIÁVEIS PARA ELIMINAR RESÍDUOS
  valorFinalTensaoDC = 0;
  mediaTotalTensaoDC = 0;
  valorSensorACS712 = 0;
  j = 0;
  
    
  //VERIFICA SE O ARDUINO ESTÁ SENDO LIGADO E CARREGA AS 2 LOGOS INICIAIS
  if(inicio == true){  
    lcd.clear();
    lcd.setCursor(40,1);
    lcd.draw(ENG_MEC_MONO, 48, 48);
    delay(2000);

    lcd.clear();
    lcd.setCursor(40,1);
    lcd.draw(UNIP_MONO, 48, 37);
    delay(2000);

    digitalWrite(cortaTensao, HIGH);

    inicio = false;
    
  }

  for(int i=0; i < amostragem; i++){

    //REALIZA LEITURA NO SENSOR DE CORRENTE ACS712
    sensorValueAux = (analogRead(sensorCorrenteDC) -511.5);

    valorSensorACS712 += pow(sensorValueAux,2);
    
    //REALIZA A LEITURA DE TENSÃO NA PORTA ANALÓGICA
    valorTensaoDC = analogRead(sensorTensaoDC);

    //CALCULA O VALOR A PARTIR DA RESOLUÇÃO
    valorTensaoDC = (valorTensaoDC*voltsPorUnidade);

    //INCLUI NO CÁLCULO OS VALORES DO DIVISOR DE TENSÃO
    mediaTotalTensaoDC = mediaTotalTensaoDC + (valorTensaoDC / (R2 / (R1 + R2)));

    //INTERVALO ENTRE AS LEITURAS
    delay(1);
  }
  
  //MÉDIA DOS VALORES DE LEITURA DE TENSÃO
  valorFinalTensaoDC = mediaTotalTensaoDC / amostragem;

  //MÉDIA DOS VALORES DE LEITURA DE CORRENTE
  valorSensorACS712 = (sqrt(valorSensorACS712 / amostragem)) * voltsPorUnidade;

  //ATRIBUINDO A SENSIBILIDADE DO SENSOR AO VALOR DE CORRENTE
  valorCorrenteDC = (valorSensorACS712 / sensibilidade);

  //VERIFICA O VALOR DE CORRENTE E SE CASO VERDADEIRO CORTA O FORNECIMENTO DE TENSÃO PARA A BATERIA
    if(valorCorrenteDC < 0.20){
      digitalWrite(cortaTensao,LOW);
      interacao = 1;
    }
  
  
    //SAÍDA DE INFORMAÇÕES NO MONITOR SERIAL
    Serial.print("VALOR DE TENSÃO: ");
    Serial.print(valorFinalTensaoDC);
    Serial.println("VOLTS");
  
    if(interacao == 0){
      
    //MOSTRA NO DISPLAY A LEITURA DE TENSÃO
    lcd.clear();
    lcd.setCursor(0,0);
    lcd.setFontSize(FONT_SIZE_MEDIUM);
    lcd.print("TENSAO: ");
    lcd.print(valorFinalTensaoDC);
    lcd.println("V");

    //MOSTRA NO DISPLAY A LEITURA DE CORRENTE
    lcd.setCursor(0,2);
    lcd.print("DC: ");
    lcd.print(valorCorrenteDC);
    lcd.println("A");

    // MOSTRA NO DISPLAY O STATUS
    for (j = 0; j<5; j++){
      if (j == 0){
        carregamento = "CARREGANDO";
      }
      else{
        carregamento.concat(".");
      }
      lcd.setCursor(0,5);
      lcd.print(carregamento);
      delay(1000);
    }
  }

  else{
    lcd.clear();
    lcd.setFontSize(FONT_SIZE_XLARGE);
    lcd.setCursor(20,0);
    lcd.print("CARREGADO!");
    lcd.setFontSize(FONT_SIZE_SMALL);
    lcd.setCursor(0,4);
    lcd.println("POR FAVOR, DESCONECTE");
    lcd.setCursor(35,6);
    lcd.print("A BATERIA!");
  }
  
} 
